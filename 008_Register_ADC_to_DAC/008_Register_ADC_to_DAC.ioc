# file: 008_Register_ADC_to_DAC.ioc
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Mcu.Family=STM32F4
Mcu.Name=STM32F446R(C-E)Tx
Mcu.Package=LQFP64
NVIC.PriorityGroup=NVIC_PRIORITYGROUP_4
ProjectManager.HeapSize=0x200
ProjectManager.StackSize=0x400
ProjectManager.TargetToolchain=STM32CubeIDE
RCC.CortexFreq_Value=16000000
RCC.USBFreq_Value=96000000
RCC.VCOOutputFreq_Value=192000000
board=custom

// file: Core/Src/main.c
/* USER CODE BEGIN Header */
/**
  ******************************************************************************
  * @file           : main.c
  * @brief          : Main program body
  ******************************************************************************
  * @attention
  *
  * Copyright (c) 2024 STMicroelectronics.
  * All rights reserved.
  *
  * This software is licensed under terms that can be found in the LICENSE file
  * in the root directory of this software component.
  * If no LICENSE file comes with this software, it is provided AS-IS.
  *
  ******************************************************************************
  */
/* USER CODE END Header */
#include "main.h"

/* USER CODE BEGIN PTD */
uint16_t adc_value;

/* USER CODE END PTD */

void SystemClock_Config(void);

void delay(uint32_t time)
{
	while(time--);
}

void GPIO_Config()
{

	RCC->AHB1ENR |= (1<<0);					//GPIOA Enable
	GPIOA->MODER |= 0x00000003;				//A0 Analog Mode
	GPIOC->OSPEEDR = 0x0C000003;				//A0 pin high speed
}

void ADC_Config()
{
	RCC->APB2ENR |= 0x00000100;				//ADC1 Clock Enable

	ADC1->CR1 &= ~(1<<25);					//Resolution 12 bit
	ADC1->CR1 &= ~(1<<24);
	ADC1->CR2 |= 0x00000001;					//ADC Enable

	ADC1->SMPR2 |= 0x00000003;					//A0 sample time 56 cycles

	ADC->CCR |= 0x00010000;						//01: PCLK2 divided by 4

}

void DAC1_Config()
{
	RCC->APB1ENR |= (1<<29);				// DAC Clock enable

	DAC->CR |= (1<<0);						// DAC Channel 1 enable
}

uint16_t Read_ADC()
{
	uint16_t value;					//ADC'de okunan degerler bunun icinde olucak

	ADC1->CR2 |= (1<<30);			//Start conversion of regular channels

	while (!(ADC1->SR & (1<<1)));  //EOC Flagi kalkana kadar bekle

	value = ADC1->DR;

	return value;

}

int main(void)
{

  /* MCU Configuration--------------------------------------------------------*/

  /* Reset of all peripherals, Initializes the Flash interface and the Systick. */
  HAL_Init();

  /* Configure the system clock */
  SystemClock_Config();
  GPIO_Config();
  ADC_Config();
  DAC1_Config();

  /* Initialize all configured peripherals */

  /* Infinite loop */
  while (1)
  {

    /* USER CODE BEGIN 3 */
	adc_value = Read_ADC();

	DAC->DHR12R1 = adc_value;
	delay(1680);

  }
  /* USER CODE END 3 */
}

void SystemClock_Config(void)
{
  RCC_OscInitTypeDef RCC_OscInitStruct = {0};
  RCC_ClkInitTypeDef RCC_ClkInitStruct = {0};

  /** Configure the main internal regulator output voltage
  */
  __HAL_RCC_PWR_CLK_ENABLE();
  __HAL_PWR_VOLTAGESCALING_CONFIG(PWR_REGULATOR_VOLTAGE_SCALE3);

  /** Initializes the RCC Oscillators according to the specified parameters
  * in the RCC_OscInitTypeDef structure.
  */
  RCC_OscInitStruct.OscillatorType = RCC_OSCILLATORTYPE_HSI;
  RCC_OscInitStruct.HSIState = RCC_HSI_ON;
  RCC_OscInitStruct.HSICalibrationValue = RCC_HSICALIBRATION_DEFAULT;
  RCC_OscInitStruct.PLL.PLLState = RCC_PLL_NONE;
  if (HAL_RCC_OscConfig(&RCC_OscInitStruct) != HAL_OK)
  {
    Error_Handler();
  }

  /** Initializes the CPU, AHB and APB buses clocks
  */
  RCC_ClkInitStruct.ClockType = RCC_CLOCKTYPE_HCLK|RCC_CLOCKTYPE_SYSCLK
                              |RCC_CLOCKTYPE_PCLK1|RCC_CLOCKTYPE_PCLK2;
  RCC_ClkInitStruct.SYSCLKSource = RCC_SYSCLKSOURCE_HSI;
  RCC_ClkInitStruct.AHBCLKDivider = RCC_SYSCLK_DIV1;
  RCC_ClkInitStruct.APB1CLKDivider = RCC_HCLK_DIV1;
  RCC_ClkInitStruct.APB2CLKDivider = RCC_HCLK_DIV1;

  if (HAL_RCC_ClockConfig(&RCC_ClkInitStruct, FLASH_LATENCY_0) != HAL_OK)
  {
    Error_Handler();
  }
}

void Error_Handler(void)
{
  __disable_irq();
  while (1)
  {
  }
}
